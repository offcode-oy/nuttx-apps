## examples/nng_test/Kconfig
```kconfig
#
# For a description of the syntax of this configuration file,
# see the file kconfig-language.txt in the NuttX tools repository.
#

config EXAMPLES_NNG
	tristate "libnng examples"
	default n
	depends on NETUTILS_LIBNNG
	---help---
		Enable the NNG examples

if EXAMPLES_NNG


endif
```

## netutils/libnng/Kconfig
```kconfig
#
# For a description of the syntax of this configuration file,
# see the file kconfig-language.txt in the NuttX tools repository.
#

config NETUTILS_LIBNNG
	bool "Nanomsg-ng library (current version)"
	default n
	---help---
		Enables the Nanomsg-ng library.

if NETUTILS_LIBNNG

config NETUTILS_LIBNNG_URL
	string "URL where nanomsg-ng library can be downloaded"
	default "https://github.com/nanomsg/nng/archive"

config NETUTILS_LIBNNG_VERSION
	string "Version number"
	default "1.5.2"

endif
```

## netutils/libzmq/Kconfig
```kconfig
#
# For a description of the syntax of this configuration file,
# see the file kconfig-language.txt in the NuttX tools repository.
#

config NETUTILS_LIBZMQ
	bool "zeromq library (current version)"
	default n
	---help---
		Enables the zeromq library.

if NETUTILS_LIBZMQ

config NETUTILS_LIBZMQ_URL
	string "URL where zeromq library can be downloaded"
	default "https://github.com/zeromq/libzmq/archive"

config NETUTILS_LIBZMQ_VERSION
	string "Version number"
	default "4.3.4"

endif
```
